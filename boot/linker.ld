ENTRY(stage2_start)

SECTIONS
{
    . = 0x7e00;

    .text : {
        build/stage2.o(.text)
        build/kernel.o(.text)
        build/terminal.o(.text)
        build/isr.o(.text)
        build/isr_asm.o(.text)
        build/idt.o(.text)
        build/idt_load.o(.text)
        build/pic.o(.text)
        build/irq.o(.text)
        build/irq_asm.o(.text)
        build/keyboard.o(.text)
        build/kstring.o(.text)
        build/kprintf.o(.text)
        build/ata.o(.text)
        build/vigil_memory.o(.text)
        build/fs.o(.text)
        build/timer.o(.text)
        build/heap.o(.text)
        build/font.o(.text)
        build/graphics.o(.text)
        build/mouse.o(.text)
        build/button.o(.text)
        build/title_bar.o(.text)
        build/taskbar.o(.text)
        build/menu.o(.text)
        build/prompt.o(.text)
        build/vigil_api.o(.text)
        build/loader.o(.text)
        
        build/launcher.o(.text)
        build/shell.o(.text)
        build/notepad.o(.text)
        build/files.o(.text)
    }

    .rodata : {
        build/stage2.o(.rodata)
        build/kernel.o(.rodata)
        build/terminal.o(.rodata)
        build/isr.o(.rodata)
        build/isr_asm.o(.rodata)
        build/idt.o(.rodata)
        build/idt_load.o(.rodata)
        build/pic.o(.rodata)
        build/irq.o(.rodata)
        build/irq_asm.o(.rodata)
        build/keyboard.o(.rodata)
        build/kstring.o(.rodata)
        build/kprintf.o(.rodata)
        build/ata.o(.rodata)
        build/vigil_memory.o(.rodata)
        build/fs.o(.rodata)
        build/timer.o(.rodata)
        build/heap.o(.rodata)
        build/font.o(.rodata)
        build/graphics.o(.rodata)
        build/mouse.o(.rodata)
        build/button.o(.rodata)
        build/title_bar.o(.rodata)
        build/taskbar.o(.rodata)
        build/menu.o(.rodata)
        build/prompt.o(.rodata)
        build/vigil_api.o(.rodata)
        build/loader.o(.rodata)

        build/launcher.o(.rodata)
        build/shell.o(.rodata)
        build/notepad.o(.rodata)
        build/files.o(.rodata)
    }

    .data : {
        build/stage2.o(.data)
        build/kernel.o(.data)
        build/terminal.o(.data)
        build/isr.o(.data)
        build/isr_asm.o(.data)
        build/idt.o(.data)
        build/idt_load.o(.data)
        build/pic.o(.data)
        build/irq.o(.data)
        build/irq_asm.o(.data)
        build/keyboard.o(.data)
        build/kstring.o(.data)
        build/kprintf.o(.data)
        build/ata.o(.data)
        build/vigil_memory.o(.data)
        build/fs.o(.data)
        build/timer.o(.data)
        build/heap.o(.data)
        build/font.o(.data)
        build/graphics.o(.data)
        build/mouse.o(.data)
        build/button.o(.data)
        build/title_bar.o(.data)
        build/taskbar.o(.data)
        build/menu.o(.data)
        build/prompt.o(.data)
        build/vigil_api.o(.data)
        build/loader.o(.data)

        build/launcher.o(.data)
        build/shell.o(.data)
        build/notepad.o(.data)
        build/files.o(.data)
    }

    .bss : {
        __bss_start = .;
        build/stage2.o(.bss)
        build/kernel.o(.bss)
        build/terminal.o(.bss)
        build/isr.o(.bss)
        build/isr_asm.o(.bss)
        build/idt.o(.bss)
        build/idt_load.o(.bss)
        build/pic.o(.bss)
        build/irq.o(.bss)
        build/irq_asm.o(.bss)
        build/keyboard.o(.bss)
        build/kstring.o(.bss)
        build/kprintf.o(.bss)
        build/ata.o(.bss)
        build/vigil_memory.o(.bss)
        build/fs.o(.bss)
        build/timer.o(.bss)
        build/heap.o(.bss)
        build/font.o(.bss)
        build/graphics.o(.bss)
        build/mouse.o(.bss)
        build/button.o(.bss)
        build/title_bar.o(.bss)
        build/taskbar.o(.bss)
        build/menu.o(.bss)
        build/prompt.o(.bss)
        build/vigil_api.o(.bss)
        build/loader.o(.bss)
        
        build/launcher.o(.bss)
        build/shell.o(.bss)
        build/notepad.o(.bss)
        build/files.o(.bss)
        __bss_end = .;
    }
}
